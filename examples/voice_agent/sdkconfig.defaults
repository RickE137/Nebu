## examples/voice_agent/sdkconfig.defaults
```kconfig
CONFIG_IDF_TARGET="esp32s3"

# Configuración de memoria para ESP32S3-WROOM-1 (16MB Flash + 8MB PSRAM)
CONFIG_ESP32S3_SPIRAM_SUPPORT=y
CONFIG_SPIRAM=y
CONFIG_SPIRAM_MODE_OCT=y
CONFIG_SPIRAM_TYPE_AUTO=y
CONFIG_SPIRAM_SIZE=8192
CONFIG_SPIRAM_SPEED_80M=y
CONFIG_SPIRAM_BOOT_INIT=y
CONFIG_SPIRAM_USE_MALLOC=y
CONFIG_SPIRAM_MEMTEST=y
CONFIG_SPIRAM_MALLOC_ALWAYSINTERNAL=16384
CONFIG_SPIRAM_TRY_ALLOCATE_WIFI_LWIP=y
CONFIG_SPIRAM_MALLOC_RESERVE_INTERNAL=32768

# Configuración de audio para INMP441 + MAX98357
CONFIG_I2S_ENABLE_DEBUG_LOG=y
CONFIG_I2S_ISR_IRAM=y
CONFIG_I2S_SUPPRESS_DEPRECATE_WARN=y
CONFIG_I2S_STD_SUPPORTED=y
CONFIG_I2S_PDM_SUPPORTED=y

# Configuración de ganancia de audio - CONSERVADOR
CONFIG_DEFAULT_RECORD_GAIN=20
CONFIG_DEFAULT_PLAYBACK_VOL=70

# Configuración I2S MONO forzada para INMP441
CONFIG_I2S_STD_MONO_MODE=y
CONFIG_I2S_STD_SLOT_LEFT_ONLY=y

# Configuración STUN mínima (mantener funcionalidad)
CONFIG_LWIP_TCP_MSS=1460

# Configuración de WiFi optimizada
CONFIG_ESP32_WIFI_STATIC_RX_BUFFER_NUM=16
CONFIG_ESP32_WIFI_DYNAMIC_RX_BUFFER_NUM=32
CONFIG_ESP32_WIFI_DYNAMIC_TX_BUFFER_NUM=32
CONFIG_ESP32_WIFI_TX_BA_WIN=6
CONFIG_ESP32_WIFI_RX_BA_WIN=6

# Configuración de sistema optimizada
CONFIG_FREERTOS_HZ=1000
CONFIG_ESP_SYSTEM_PANIC_PRINT_REBOOT=y
CONFIG_ESP_CONSOLE_UART_DEFAULT=y
CONFIG_ESP_CONSOLE_UART_NUM=0
CONFIG_ESP_CONSOLE_UART_BAUDRATE=115200

# Configuración de memoria Flash
CONFIG_ESPTOOLPY_FLASHMODE_QIO=y
CONFIG_ESPTOOLPY_FLASHFREQ_80M=y
CONFIG_ESPTOOLPY_FLASHSIZE_16MB=y

# Configuración de rendimiento
CONFIG_ESP32S3_DEFAULT_CPU_FREQ_240=y

# Configuraciones LiveKit mantenidas
CONFIG_FREERTOS_USE_TRACE_FACILITY=y
CONFIG_FREERTOS_VTASKLIST_INCLUDE_COREID=y
CONFIG_FREERTOS_GENERATE_RUN_TIME_STATS=y
CONFIG_LWIP_SNTP_MAX_SERVERS=2
CONFIG_MBEDTLS_SSL_PROTO_DTLS=y
CONFIG_MBEDTLS_SSL_DTLS_SRTP=y
CONFIG_CODEC_I2C_BACKWARD_COMPATIBLE=n
CONFIG_IDF_EXPERIMENTAL_FEATURES=y
CONFIG_PARTITION_TABLE_CUSTOM=y
CONFIG_MBEDTLS_EXTERNAL_MEM_ALLOC=y

# Stack sizes aumentados para evitar overflow (conservador según ESP-IDF docs)
CONFIG_FREERTOS_TIMER_TASK_STACK_DEPTH=6144
CONFIG_ESP_MAIN_TASK_STACK_SIZE=6144
CONFIG_FREERTOS_MAIN_TASK_STACK_SIZE=6144
CONFIG_FREERTOS_UNICORE=n
CONFIG_FREERTOS_USE_STATS_FORMATTING_FUNCTIONS=y
CONFIG_FREERTOS_TASK_FUNCTION_WRAPPER=y
CONFIG_FREERTOS_CHECK_STACKOVERFLOW_PTR=y
CONFIG_FREERTOS_CHECK_STACKOVERFLOW_CANARY=y
CONFIG_FREERTOS_WATCHPOINT_END_OF_STACK=y

# Configuración específica para LiveKit engine task (según LiveKit docs)
CONFIG_ESP_WEBSOCKET_CLIENT_TASK_STACK_SIZE=6144
CONFIG_ESP_WEBSOCKET_CLIENT_TASK_PRIORITY=5
CONFIG_ESP_WEBSOCKET_CLIENT_ENABLE_DYNAMIC_BUFFER=y
CONFIG_ESP_WEBSOCKET_CLIENT_BUFFER_SIZE=2048

# Configuración específica para tu hardware
CONFIG_BSP_I2C_NUM=0
CONFIG_I2C_MASTER_NUM=0
CONFIG_I2C_SLAVE_NUM=0

# Configuración específica para LiveKit engine task (ya configurado arriba)

# Configuración de memoria para WebRTC
CONFIG_ESP_WEBSOCKET_CLIENT_ENABLE_SSL=y
CONFIG_ESP_WEBSOCKET_CLIENT_ENABLE_SSL_MUTUAL_AUTH=n
CONFIG_ESP_WEBSOCKET_CLIENT_ENABLE_SSL_SKIP_COMMON_NAME=y

# Configuración WiFi (CAMBIAR CON TUS DATOS)
CONFIG_WIFI_SSID="Bryan"
CONFIG_WIFI_PASSWORD="bryan003"

# Configuración MbedTLS mínima y segura (según ESP-IDF docs oficiales)
CONFIG_MBEDTLS_DYNAMIC_BUFFER=y
CONFIG_MBEDTLS_DYNAMIC_FREE_PEER_CERT=y
CONFIG_MBEDTLS_DYNAMIC_FREE_CA_CERT=y

# Configuración MbedTLS conservadora (mantener funcionalidad)

# Configuración LiveKit (TOKEN DIRECTO)
CONFIG_LK_USE_SANDBOX=n
CONFIG_LK_USE_PREGENERATED=y
CONFIG_LK_SERVER_URL="wss://brody-v541z1he.livekit.cloud"
CONFIG_LK_TOKEN="eyJhbGciOiJIUzI1NiIsInR5cCI6IkpXVCJ9.eyJleHAiOjE3NTkwMTY0NzEsImlzcyI6IkFQSTZIdmVxU1Z5U0NVcCIsIm5hbWUiOiJlc3AzMi1kZXZpY2UtMDAxIiwibmJmIjoxNzU2NDI0NDcxLCJzdWIiOiJlc3AzMi1kZXZpY2UtMDAxIiwidmlkZW8iOnsicm9vbSI6ImVzcDMyLXJvb20tMDAxIiwicm9vbUpvaW4iOnRydWV9fQ.J-10BvVEJy0UhQKpMQ7K_XxGbYy366fePjeG4IPWNdw"

# Configuración de partición personalizada para evitar conflictos
CONFIG_PARTITION_TABLE_OFFSET=0x8000
CONFIG_PARTITION_TABLE_TWO_OTA=y
CONFIG_PARTITION_TABLE_CUSTOM_FILENAME="partitions.csv"
CONFIG_PARTITION_TABLE_FILENAME="partitions.csv"
```

## examples/voice_agent/sdkconfig.defaults.esp32s3
```kconfig
# Configuración específica para ESP32S3-WROOM-1 con INMP441 + MAX98357

# Configuración de memoria para ESP32S3-WROOM-1 (16MB Flash + 8MB PSRAM)
CONFIG_ESP32S3_SPIRAM_SUPPORT=y
CONFIG_SPIRAM=y
CONFIG_SPIRAM_MODE_OCT=y
CONFIG_SPIRAM_TYPE_AUTO=y
CONFIG_SPIRAM_SIZE=8192
CONFIG_SPIRAM_SPEED_80M=y
CONFIG_SPIRAM_BOOT_INIT=y
CONFIG_SPIRAM_USE_MALLOC=y
CONFIG_SPIRAM_MEMTEST=y
CONFIG_SPIRAM_MALLOC_ALWAYSINTERNAL=16384
CONFIG_SPIRAM_TRY_ALLOCATE_WIFI_LWIP=y
CONFIG_SPIRAM_MALLOC_RESERVE_INTERNAL=32768

# Configuración de audio para INMP441 + MAX98357
CONFIG_I2S_ENABLE_DEBUG_LOG=y
CONFIG_I2S_ISR_IRAM=y
CONFIG_I2S_SUPPRESS_DEPRECATE_WARN=y
CONFIG_I2S_STD_SUPPORTED=y
CONFIG_I2S_PDM_SUPPORTED=y

# Configuración de WiFi optimizada
CONFIG_ESP32_WIFI_STATIC_RX_BUFFER_NUM=16
CONFIG_ESP32_WIFI_DYNAMIC_RX_BUFFER_NUM=32
CONFIG_ESP32_WIFI_DYNAMIC_TX_BUFFER_NUM=32
CONFIG_ESP32_WIFI_TX_BA_WIN=6
CONFIG_ESP32_WIFI_RX_BA_WIN=6

# Configuración de sistema optimizada
CONFIG_FREERTOS_HZ=1000
CONFIG_ESP_SYSTEM_PANIC_PRINT_REBOOT=y
CONFIG_ESP_CONSOLE_UART_DEFAULT=y
CONFIG_ESP_CONSOLE_UART_NUM=0
CONFIG_ESP_CONSOLE_UART_BAUDRATE=115200

# Configuración de memoria Flash
CONFIG_ESPTOOLPY_FLASHMODE_QIO=y
CONFIG_ESPTOOLPY_FLASHFREQ_80M=y
CONFIG_ESPTOOLPY_FLASHSIZE_16MB=y

# Configuración de rendimiento
CONFIG_ESP32S3_DEFAULT_CPU_FREQ_240=y

# Configuraciones LiveKit mantenidas
CONFIG_FREERTOS_USE_TRACE_FACILITY=y
CONFIG_FREERTOS_VTASKLIST_INCLUDE_COREID=y
CONFIG_FREERTOS_GENERATE_RUN_TIME_STATS=y
CONFIG_LWIP_SNTP_MAX_SERVERS=2
CONFIG_MBEDTLS_SSL_PROTO_DTLS=y
CONFIG_MBEDTLS_SSL_DTLS_SRTP=y
CONFIG_CODEC_I2C_BACKWARD_COMPATIBLE=n
CONFIG_IDF_EXPERIMENTAL_FEATURES=y
CONFIG_PARTITION_TABLE_CUSTOM=y
CONFIG_MBEDTLS_EXTERNAL_MEM_ALLOC=y
CONFIG_FREERTOS_TIMER_TASK_STACK_DEPTH=4096

# Configuración específica para tu hardware
CONFIG_BSP_I2C_NUM=0

# Configuración de codec board personalizada
CONFIG_CODEC_BOARD_TYPE="ESP32S3_WROOM_CUSTOM"
```
